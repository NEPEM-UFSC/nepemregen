## sdkconfig.defaults
```kconfig
# ESP-IDF SDK Configuration Defaults
CONFIG_ESP_MAIN_TASK_STACK_SIZE=7168
CONFIG_ESP_SYSTEM_EVENT_TASK_STACK_SIZE=4096
CONFIG_ESP32_DEFAULT_CPU_FREQ_240=y
CONFIG_COMPILER_CXX_EXCEPTIONS=y
CONFIG_COMPILER_CXX_RTTI=y
```
